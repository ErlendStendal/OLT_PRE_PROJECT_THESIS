//SERVER
//Generated by ChatGPT 02.10.24
//Fetches data from ESP running the Client.ino

#include <esp_now.h>
#include <WiFi.h>

// Define a structure to receive messages
typedef struct struct_message {
    char text[32];
} struct_message;

// Create an instance to hold incoming data
struct_message incomingMessage;

// Callback function that will be executed when data is received
void OnDataRecv(const esp_now_recv_info_t *recv_info, const uint8_t *incomingData, int len) {
    // Optional: Access sender's MAC address
    Serial.print("Received message from ");
    for (int i = 0; i < 6; i++) {
        if (i > 0) Serial.print(":");
        Serial.printf("%02X", recv_info->src_addr[i]);
    }
    Serial.print(": ");
    
    // Copy incoming data to struct
    memcpy(&incomingMessage, incomingData, sizeof(incomingMessage));
    Serial.println(incomingMessage.text);
}

void setup() {
    // Initialize Serial Monitor
    Serial.begin(115200);
    Serial.println("ESP-NOW Server Starting...");

    // Initialize WiFi in Station mode
    WiFi.mode(WIFI_STA);
    Serial.print("ESP32 MAC Address: ");
    Serial.println(WiFi.macAddress());  // Print MAC address

    // Initialize ESP-NOW
    if (esp_now_init() != ESP_OK) {
        Serial.println("Error initializing ESP-NOW");
        while (true);
    }

    // Register the receive callback
    esp_now_register_recv_cb(OnDataRecv);

    Serial.println("ESP-NOW Server Initialized and Ready to Receive Messages.");
}

void loop() {
    // Nothing to do here
    delay(1000);
}
